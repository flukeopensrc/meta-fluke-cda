## conf/machine/fluke-cda-blackhawk.conf
```bitbake
#@TYPE: Machine
#@NAME: fluke-cda-blackhawk
#@DESCRIPTION: Machine configuration for the Cyclone V Fluke CDA Nighthawk"

require conf/machine/include/socfpga.inc

INHERIT += "blacklist"
PNBLACKLIST[customization-fluke-cda-nighthawk] = "Not supported in this product."
PNBLACKLIST[customization-fluke-cda-caldera] = "Not supported in this product."
PNBLACKLIST[customization-fluke-cda-kraken] = "Not supported in this product."
PNBLACKLIST[fluke-cia-nighthawk] = "Not supported in this product."
PNBLACKLIST[fluke-cia] = "Not supported in this product."

PREFERRED_PROVIDER_virtual/kernel = "linux-altera-lts"
PREFERRED_VERSION_linux-altera-lts = "5.4.%"

PREFERRED_PROVIDER_virtual/bootloader ?= "u-boot-socfpga"
PREFERRED_VERSION_u-boot-socfpga ?= "v2016.11%"

UBOOT_CONFIG ??= "fluke-cda-blackhawk"
UBOOT_CONFIG[fluke-cda-blackhawk] = "socfpga_fluke_cda_blackhawk_defconfig"

KMACHINE = "fluke-cda-blackhawk"

# Default kernel devicetrees
KERNEL_DEVICETREE ?= "\
	Blackhawk_soc.dtb \
"
SPL_BINARY_fluke-cda-blackhawk = "u-boot-with-spl.sfp"

MKUBIFS_ARGS = "-m 1 -e 65408 -c 4094"
UBINIZE_ARGS = "-m 1 -p 64KiB"
JFFS2_ERASEBLOCK = "0x10000"

#create partitioned disk image for eMMC using wic
IMAGE_FSTYPES_append = " wic.gz"
IMAGE_FSTYPES_append = " ubi"
IMAGE_FSTYPES_append = " jffs2"
#wic file for building partitioned disk image
WKS_FILE = "sdimage-${MACHINE}.wks.in"
```
